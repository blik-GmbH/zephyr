## sample.yaml
```
sample:
  name: LIS3DH Accelerometer/Temperature Sensor
tests:
  test:
    harness: sensor
    platform_whitelist: frdm_kw41z akita_gen2_devboard
    tags: samples sensor
    depends_on: i2c
```

## prj.conf
```kconfig
CONFIG_STDOUT_CONSOLE=y
CONFIG_SYS_LOG=y
CONFIG_I2C=y
CONFIG_SENSOR=y
CONFIG_SYS_LOG_SENSOR_LEVEL=4

CONFIG_LIS3DH=y
CONFIG_LIS3DH_NAME="LIS3DH"
CONFIG_LIS3DH_I2C_ADDR=0x18
CONFIG_LIS3DH_I2C_MASTER_DEV_NAME="I2C_1"
CONFIG_LIS3DH_ENABLE_TEMP=y
# CONFIG_LIS3DH_TRIGGER_NONE is not set
CONFIG_LIS3DH_TRIGGER_GLOBAL_THREAD=y
# CONFIG_LIS3DH_TRIGGER_OWN_THREAD is not set
CONFIG_LIS3DH_TRIGGER=y
CONFIG_LIS3DH_GPIO_DEV_NAME="GPIO_0"
CONFIG_LIS3DH_INT1_GPIO_PIN=16
CONFIG_LIS3DH_INT2_GPIO_PIN=17
# CONFIG_LIS3DH_ACCEL_RANGE_2G is not set
CONFIG_LIS3DH_ACCEL_RANGE_4G=y
# CONFIG_LIS3DH_ACCEL_RANGE_8G is not set
# CONFIG_LIS3DH_ACCEL_RANGE_16G is not set
# CONFIG_LIS3DH_POWER_MODE_NORMAL is not set
CONFIG_LIS3DH_POWER_MODE_LOW=y
CONFIG_LIS3DH_ODR_1=y

CONFIG_MINIMAL_LIBC=n
CONFIG_NEWLIB_LIBC=y
```

## src/main.c
```c
/*
 * Copyright (c) 2016 Freescale Semiconductor, Inc.
 *
 * SPDX-License-Identifier: Apache-2.0
 */

#include <zephyr.h>
#include <sensor.h>
#include <gpio.h>
#include <device.h>
#include <stdio.h>
#include <adc.h>

#if defined(CONFIG_LIS3DH_TRIGGER) || defined(CONFIG_LIS3DH_TRIGGER_MANUAL)

static void trigger_handler(struct device *dev, struct sensor_trigger *trigger)
{
	ARG_UNUSED(dev);
	ARG_UNUSED(trigger);
	printf("You moved it!");
 }
#endif

void main(void)
{
	struct sensor_value accel[3];
#if defined(CONFIG_LIS3DH_ENABLE_TEMP)
	struct sensor_value temp;
#endif
	struct device *dev;
	int rc;


	dev = device_get_binding(CONFIG_LIS3DH_NAME);
	if (dev == NULL) {
		printk("Could not get lis3dh device\n");
	}
#if defined(CONFIG_LIS3DH_TRIGGER) || defined(CONFIG_LIS3DH_TRIGGER_MANUAL)

	/* Take a minimal threshold to trigger easily */
	struct sensor_value threshold = {
		.val1 = 1,
		.val2 = 0,
	};
	/* Trigger as soon as one measurement is above threshold */
	struct sensor_value duration = {
		.val1 = 2,
		.val2 = 0,
	};
	struct sensor_trigger trig = {
		.type = SENSOR_TRIG_DELTA,
		.chan = SENSOR_CHAN_ACCEL_XYZ,
	};


	if (sensor_attr_set(dev, SENSOR_CHAN_ACCEL_XYZ,
	        SENSOR_ATTR_SLOPE_TH, &threshold) < 0) {
		printk("Could not set threshold\n");
	}

	if (sensor_attr_set(dev, SENSOR_CHAN_ACCEL_XYZ,
	        SENSOR_ATTR_SLOPE_DUR, &duration) < 0) {
		printk("Could not set duration.\n");
	}


	if (sensor_trigger_set(dev, &trig, trigger_handler) < 0) {
		printk("Could not set trigger\n");
	}
#endif
	/* The first measurement isn't ready quite yet */
	k_sleep(100);

	while (1)
	{
		rc = sensor_sample_fetch_chan(dev, SENSOR_CHAN_ACCEL_XYZ);
		if (rc != 0) {
			printk("sensor_sample_fetch error: %d\n", rc);
			break;
		}

#if defined(CONFIG_LIS3DH_ENABLE_TEMP)
		rc = sensor_channel_get(dev, SENSOR_CHAN_TEMP, &temp);
		if (rc != 0) {
			printk("sensor_channel_get temp: %d\n", rc);
			break;
				}
#endif

#if !defined(CONFIG_LIS3DH_FIFO_ENABLE)
		rc = sensor_channel_get(dev, SENSOR_CHAN_ACCEL_XYZ, accel);
		if (rc != 0) {
			printk("sensor_channel_get accel: %d\n", rc);
			break;
		}
		printk(" AX= %d.%d   AY= %d.%d   AZ= %d.%d\n",
			accel[0].val1, accel[0].val2,
			accel[1].val1, accel[1].val2,
			accel[2].val1, accel[2].val2);
#endif

#if defined(CONFIG_LIS3DH_FIFO_ENABLE)
		for (int i = 0; i < 32; i++) {

			sensor_channel_get(dev, SENSOR_CHAN_ACCEL_XYZ, accel);
			printk(" AX= %d.%d   AY= %d.%d   AZ= %d.%d\n",
			accel[0].val1, accel[0].val2,
			accel[1].val1, accel[1].val2,
			accel[2].val1, accel[2].val2);
		}
#endif


		k_sleep(1000);



	}
}
```
