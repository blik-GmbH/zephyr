## prj.conf
```kconfig
CONFIG_STDOUT_CONSOLE=y
CONFIG_SYS_LOG=y
CONFIG_I2C=y
CONFIG_SENSOR=y
CONFIG_SYS_LOG_SENSOR_LEVEL=4
```

## src/main.c
```c
/*
 * Copyright (c) 2016 Freescale Semiconductor, Inc.
 *
 * SPDX-License-Identifier: Apache-2.0
 */

#include <zephyr.h>
#include <device.h>
#include <stdio.h>

#include "MKW41Z4.h"

/* --- PRINTF_BYTE_TO_BINARY macro's --- */
#define PRINTF_BINARY_PATTERN_INT8 "%c%c%c%c%c%c%c%c"
#define PRINTF_BYTE_TO_BINARY_INT8(i)    \
    (((i) & 0x80ll) ? '1' : '0'), \
    (((i) & 0x40ll) ? '1' : '0'), \
    (((i) & 0x20ll) ? '1' : '0'), \
    (((i) & 0x10ll) ? '1' : '0'), \
    (((i) & 0x08ll) ? '1' : '0'), \
    (((i) & 0x04ll) ? '1' : '0'), \
    (((i) & 0x02ll) ? '1' : '0'), \
    (((i) & 0x01ll) ? '1' : '0')

#define PRINTF_BINARY_PATTERN_INT16 \
    PRINTF_BINARY_PATTERN_INT8              PRINTF_BINARY_PATTERN_INT8
#define PRINTF_BYTE_TO_BINARY_INT16(i) \
    PRINTF_BYTE_TO_BINARY_INT8((i) >> 8),   PRINTF_BYTE_TO_BINARY_INT8(i)
#define PRINTF_BINARY_PATTERN_INT32 \
    PRINTF_BINARY_PATTERN_INT16             PRINTF_BINARY_PATTERN_INT16
#define PRINTF_BYTE_TO_BINARY_INT32(i) \
    PRINTF_BYTE_TO_BINARY_INT16((i) >> 16), PRINTF_BYTE_TO_BINARY_INT16(i)
#define PRINTF_BINARY_PATTERN_INT64    \
    PRINTF_BINARY_PATTERN_INT32             PRINTF_BINARY_PATTERN_INT32
#define PRINTF_BYTE_TO_BINARY_INT64(i) \
    PRINTF_BYTE_TO_BINARY_INT32((i) >> 32), PRINTF_BYTE_TO_BINARY_INT32(i)
/* --- end macros --- */

void read_and_print_mac()
{
	const uint32_t mac_msb = RSIM->MAC_MSB;
	const uint32_t mac_lsb = RSIM->MAC_LSB;
	printf("MAC_LSB: " PRINTF_BINARY_PATTERN_INT32 "\n", PRINTF_BYTE_TO_BINARY_INT32(mac_lsb));
	printf("MAC_MSB: " PRINTF_BINARY_PATTERN_INT32 "\n", PRINTF_BYTE_TO_BINARY_INT32(mac_msb));

	uint64_t mac = ((mac_msb << 32) | mac_lsb);

	uint8_t *m = &mac;
	printf("MAC: %02x:%02x:%02x:%02x:%02x:%02x\n",
	       m[5], m[4], m[3], m[2], m[1], m[0]);
	printf("\n");
}

void read_and_print_uid()
{
	const uint32_t uidl = SIM->UIDL;
	const uint32_t uidml = SIM->UIDML;
	const uint32_t uidmh = SIM->UIDMH;

	printf("UIDMH: " PRINTF_BINARY_PATTERN_INT32 "\n", PRINTF_BYTE_TO_BINARY_INT32(uidmh));
	printf("UIDML: " PRINTF_BINARY_PATTERN_INT32 "\n", PRINTF_BYTE_TO_BINARY_INT32(uidml));
	printf("UIDL:  " PRINTF_BINARY_PATTERN_INT32 "\n", PRINTF_BYTE_TO_BINARY_INT32(uidl));
	printf("UID: %02x:%02x:%02x:%02x:" \
		"%02x:%02x:%02x:%02x:" \
		"%02x:%02x:%02x:%02x",
			((u8_t*)(&uidmh))[3],
			((u8_t*)(&uidmh))[2],
			((u8_t*)(&uidmh))[1],
			((u8_t*)(&uidmh))[0],

			((u8_t*)(&uidml))[3],
			((u8_t*)(&uidml))[2],
			((u8_t*)(&uidml))[1],
			((u8_t*)(&uidml))[0],

			((u8_t*)(&uidl))[3],
			((u8_t*)(&uidl))[2],
			((u8_t*)(&uidl))[1],
			((u8_t*)(&uidl))[0]);
	printf("\n");
}

void main(void)
{
	read_and_print_mac();
	read_and_print_uid();
}
```
