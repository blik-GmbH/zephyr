## boards/arm/akita_gen2/Kconfig.board
```kconfig
# Kconfig - AKITA-GEN2 board
#
# Copyright (c) 2018, blik GmbH
#
# SPDX-License-Identifier: Apache-2.0
#

config BOARD_AKITA_GEN2
	bool "blik AKITA Gen2"
	depends on SOC_SERIES_KINETIS_KWX
	select SOC_PART_NUMBER_MKW41Z512VHT4
	select HAS_DTS_I2C_DEVICE
```

## boards/arm/akita_gen2/Kconfig.defconfig
```kconfig
# Kconfig - AKITA-GEN2 board
#
# Copyright (c) 2018, blik GmbH
#
# SPDX-License-Identifier: Apache-2.0
#

if BOARD_AKITA_GEN2

config BOARD
	default akita_gen2

config OSC_XTAL0_FREQ
	default 32000000

config MCG_FRDIV
	default 5

config MCG_FCRDIV
	default 0

if PINMUX_MCUX

config PINMUX_MCUX_PORTA
	def_bool y

config PINMUX_MCUX_PORTB
	def_bool y

config PINMUX_MCUX_PORTC
	def_bool y

endif # PINMUX_MCUX

if GPIO_MCUX

config GPIO_MCUX_PORTA
	def_bool y

config GPIO_MCUX_PORTB
	def_bool n

config GPIO_MCUX_PORTC
	def_bool y

endif # GPIO_MCUX

if UART_MCUX_LPUART

config UART_MCUX_LPUART_0
	def_bool y if UART_CONSOLE

endif # UART_MCUX

if I2C

config I2C_1
	def_bool y

endif # I2C

if ADC

config ADC_0
	def_bool y

endif # ADC

if SPI

config SPI_0
	def_bool y

endif # SPI

if LIS3DH

config LIS3DH_GPIO_NAME
	default GPIO_MCUX_PORTC_NAME

config LIS3DH_INT1_GPIO_PIN
	default 4

config LIS3DH_INT2_GPIO_PIN
	default 5

endif # LIS3DH

endif # BOARD_AKITA_GEN2
```

## boards/arm/akita_gen2_devboard/Kconfig.board
```kconfig
# Kconfig - AKITA-GEN2 devboard
#
# Copyright (c) 2017, NXP
#
# SPDX-License-Identifier: Apache-2.0
#

config BOARD_AKITA_GEN2_DEVBOARD
	bool "blik AKITA Gen2 devboard"
	depends on SOC_SERIES_KINETIS_KWX
	select SOC_PART_NUMBER_MKW41Z512VHT4
	select HAS_DTS_I2C_DEVICE
```

## boards/arm/akita_gen2_devboard/Kconfig.defconfig
```kconfig
# Kconfig - AKITA-GEN2 devboard
#
# Copyright (c) 2017, NXP
#
# SPDX-License-Identifier: Apache-2.0
#

if BOARD_AKITA_GEN2_DEVBOARD

config BOARD
	default akita_gen2_devboard

config OSC_XTAL0_FREQ
	default 32000000

config MCG_FRDIV
	default 5

config MCG_FCRDIV
	default 0

if PINMUX_MCUX

config PINMUX_MCUX_PORTA
	def_bool y

config PINMUX_MCUX_PORTB
	def_bool y if ADC_0

config PINMUX_MCUX_PORTC
	def_bool y

endif # PINMUX_MCUX

if GPIO_MCUX

config GPIO_MCUX_PORTA
	def_bool y

config GPIO_MCUX_PORTB
	def_bool n

config GPIO_MCUX_PORTC
	def_bool y

endif # GPIO_MCUX

if UART_MCUX_LPUART

config UART_MCUX_LPUART_0
	def_bool y if UART_CONSOLE

endif # UART_MCUX

if I2C

config I2C_1
	def_bool y

endif # I2C

if SPI

config SPI_0
    def_bool n

config SPI_0_IRQ_PRI
    default 10

config SPI_1
    def_bool n

config SPI_1_IRQ_PRI
    default 11

endif # SPI

if ADC

config ADC_0
	def_bool y

endif # ADC


if FLASH
	config SPI_1
		def_bool y
	config SPI_MCUX_DSPI
		def_bool y
	config SPI_FLASH_W25QXXXX
		def_bool y
	config SPI_FLASH_W25QXXXX_SPI_NAME
		default "SPI_1"
	choice SPI_FLASH_W25QXXXX_DEVICE
		default SPI_FLASH_W25QXXXX_DEVICE_W25QXXFW
	endchoice
	config CONFIG_SPI_FLASH_W25QXXXX_SPI_FREQ_0
		default 500000
	config SPI_FLASH_W25QXXXX_SPI_SLAVE
		default 0

endif # FLASH


if FILE_SYSTEM_NFFS

	config FS_NFFS_FLASH_DEV_NAME
		default "W25QXXXX"
	config FS_NFFS_NUM_INODES
		default 100
	config FS_NFFS_NUM_BLOCKS
		default 100
	config FS_NFFS_NUM_FILES
		default 4
	config FS_NFFS_NUM_DIRS
		default 4
	config FS_NFFS_NUM_CACHE_INODES
		default 1
	config FS_NFFS_NUM_CACHE_BLOCKS
		default 1
	config NFFS_FILESYSTEM_MAX_AREAS
		default 8
	config NFFS_FILESYSTEM_MAX_BLOCK_SIZE
		default 256

endif # FILE_SYSTEM_NFFS


if FXOS8700

config FXOS8700_GPIO_NAME
	default GPIO_MCUX_PORTC_NAME

config FXOS8700_GPIO_PIN
	default 1

config FXOS8700_DRDY_INT1
	def_bool y

endif # FXOS8700


if LIS3DH

config LIS3DH_GPIO_NAME
	default GPIO_MCUX_PORTC_NAME

config LIS3DH_INT1_GPIO_PIN
	default 4

config LIS3DH_INT2_GPIO_PIN
	default 5

endif # LIS3DH

endif # BOARD_FRDM_KW41Z
```

## drivers/flash/Kconfig
```kconfig
# Kconfig - Flash driver configuration options

#
# Copyright (c) 2016 Intel Corporation
#
# SPDX-License-Identifier: Apache-2.0
#

#
# Flash driver
#
config FLASH_HAS_DRIVER_ENABLED
	bool
	default n
	help
	  This option is enabled when any flash driver is enabled.

config FLASH_HAS_PAGE_LAYOUT
	bool
	default n
	help
	  This option is enabled when the SoC flash driver supports
	  retrieving the layout of flash memory pages.

menuconfig FLASH
	bool
	prompt "Flash hardware support"
	default n
	help
	  Enable support for the flash hardware.

config FLASH_PAGE_LAYOUT
	bool "API for retrieving the layout of pages"
	depends on FLASH && FLASH_HAS_PAGE_LAYOUT
	default n
	help
	  Enables API for retrieving the layout of flash memory pages.

config SPI_FLASH_W25QXXXX
	bool
	prompt "SPI NOR Flash Winbond W25QXXXX"
	select FLASH_HAS_DRIVER_ENABLED
	depends on SPI && FLASH

config SPI_FLASH_W25QXXXX_SPI_NAME
	string
	prompt "SPI controller device name"
	depends on SPI_FLASH_W25QXXXX
	default ""

choice SPI_FLASH_W25QXXXX_DEVICE
	bool
	depends on SPI_FLASH_W25QXXXX
	prompt "W25QXXXX SPI Flash Device"
	config SPI_FLASH_W25QXXXX_DEVICE_W25QXXDV
		bool "W25QXXDV"
	config SPI_FLASH_W25QXXXX_DEVICE_W25QXXFW
		bool "W25QXXFW"
	help
		The particular Flash device defined by the two-letter suffix in the
		device name, e.g. W25Q16DV or W25Q16FW.
endchoice

config SPI_FLASH_W25QXXXX_DRV_NAME
	string
	prompt "W25QXXXX SPI flash driver name"
	depends on SPI_FLASH_W25QXXXX
	default "W25QXXXX"
	help
		This the name with that the driver is registered in
		the kernel.
		The name can be other modules and user software to
		get the device binding to the Flash device.

config SPI_FLASH_W25QXXXX_INIT_PRIORITY
	int
	depends on SPI_FLASH_W25QXXXX
	default 80
	help
	  Device driver initialization priority.
	  Device is connected to SPI bus, it has to
	  be initialized after SPI driver.

config SPI_FLASH_W25QXXXX_SPI_FREQ_0
	int "SPI system frequency"
	depends on SPI_FLASH_W25QXXXX
	default 4
	help
	  This option sets the SPI controller's frequency. Beware this value
	  depends on the SPI controller being used and also on the system
	  clock.

config	SPI_FLASH_W25QXXXX_SPI_SLAVE
	int "SPI slave linked to SPI flash"
	depends on SPI_FLASH_W25QXXXX
	help
	  This option sets the SPI slave number the SPI controller has to switch
	  to when dealing with WinBond SPI flash chip.

config SPI_FLASH_W25QXXXX_FLASH_SIZE
	int "Flash size in bytes"
	depends on SPI_FLASH_W25QXXXX
	default 2097152
	help
	  This is the flash capacity in bytes.

config SOC_FLASH_QMSI
	bool
	prompt "QMSI flash driver"
	depends on QMSI && FLASH
	select FLASH_HAS_DRIVER_ENABLED
	default n
	help
	  Enable QMSI Quark flash driver.

config SOC_FLASH_QMSI_DEV_NAME
	string "QMSI flash device name"
	depends on SOC_FLASH_QMSI
	default "QUARK_FLASH"
	help
	  Specify the device name for the flash driver.

config SOC_FLASH_QMSI_CLK_COUNT_US
	int "System clk count per microsecond"
	depends on SOC_FLASH_QMSI
	default 32
	help
	  Specify the system clk cycles per microsecond.

config SOC_FLASH_QMSI_WAIT_STATES
	int "The number of flash wait states"
	depends on SOC_FLASH_QMSI
	default 1
	help
	  Specify the number of wait states for Quark flash.

config SOC_FLASH_QMSI_SYS_SIZE
	hex "SOC system flash size"
	depends on SOC_FLASH_QMSI
	help
	  Specify system flash size on the Quark SOC.

config SOC_FLASH_QMSI_API_REENTRANCY
	bool
	prompt "flash driver API reentrancy for QMSI shim driver"
	depends on SOC_FLASH_QMSI
	default n
	help
	 Enable support for QMSI flash driver API reentrancy.

config SOC_FLASH_NRF5
	bool "Nordic Semiconductor nRF5X flash driver"
	depends on FLASH && SOC_FAMILY_NRF5
	default n
	select FLASH_HAS_PAGE_LAYOUT
	select FLASH_HAS_DRIVER_ENABLED
	help
	  Enables Nordic Semiconductor nRF5X flash driver.

config SOC_FLASH_NRF5_RADIO_SYNC
	bool "Nordic nRF5x flash driver synchronized with radio"
	depends on SOC_FLASH_NRF5 && BT_CTLR
	default y
	help
	  Enable synchronization between flash memory driver and radio.

config SOC_FLASH_MCUX
	bool "MCUX flash shim driver"
	depends on FLASH && HAS_MCUX
	select FLASH_HAS_PAGE_LAYOUT
	select FLASH_HAS_DRIVER_ENABLED
	default n
	help
	  Enables the MCUX flash shim driver.
	  WARNING: This driver will disable the system interrupts for
	  the duration of the flash erase/write operations. This will
	  have an impact on the overall system performance - whether
	  this is acceptable or not will depend on the use case.

config SOC_FLASH_NIOS2_QSPI
	bool "Nios-II QSPI flash driver"
	depends on FLASH && HAS_ALTERA_HAL
	default n
	select FLASH_HAS_DRIVER_ENABLED
	help
	  Enables the Nios-II QSPI flash driver.

config SOC_FLASH_NIOS2_QSPI_DEV_NAME
	string "Nios-II QSPI flash device name"
	depends on SOC_FLASH_NIOS2_QSPI
	default "NIOS2_QSPI_FLASH"
	help
	  Specify the device name for the QSPI flash driver.

source "drivers/flash/Kconfig.stm32"

source "drivers/flash/Kconfig.sam0"
```

## drivers/watchdog/Kconfig.mkwx
```kconfig
# Kconfig - NXP Kinetis KWx WDT configuration
#
# Copyright (c) 2018 blik GmbH
# SPDX-License-Identifier: Apache-2.0

choice WDT_MKW4XZ
	bool
	depends on SOC_PART_NUMBER_MKW41Z512VHT4
	prompt "MKW41Z Watchdog Timer Timeout Setting"
	config WDT_MKW4XZ_32MS
		bool "32 ms"
	config WDT_MKW4XZ_256MS
		bool "256 ms"
	config WDT_MKW4XZ_1024MS
		bool "1024 ms"
	config WDT_MKW4XZ_8192MS
		bool "8192 ms"
	config WDT_MKW4XZ_65536MS
		bool "65536 ms"
	config WDT_MKW4XZ_262144MS
		bool "262144 ms"
	help
	  The Kinetis MKW4xZ Watchdog Timer can be configured once at power-up.
		The timeout period must therefore be pre-selected here.
endchoice
```

## dts/bindings/rtc/nxp,kinetis-rtc.yaml
```yaml
---
title: Kinetis RTC
id: nxp,kinetis-rtc
version: 0.1

description: >
    This binding gives a base representation of the Kinetis RTC

inherits:
    !include rtc.yaml

properties:
    compatible:
      type: string
      category: required
      description: compatible strings
      constraint: "nxp,kinetis-rtc"

    reg:
      type: array
      description: mmio register space
      generation: define
      category: required

    interrupts:
      type: array
      category: required
      description: required interrupts
      generation: define

...
```

## dts/bindings/sensor/st,lis3dh.yaml
```yaml
#
# Copyright (c) 2018, blik GmbH
#
# SPDX-License-Identifier: Apache-2.0
#
---
title: STMicroelectronics MEMS sensors LIS3DH
id: st,lis3dh
version: 0.1

description: >
    This binding gives a base representation of LIS3DH magnetometer

inherits:
    !include i2c-device.yaml

properties:
    compatible:
      constraint: "st,lis3dh"

...
```

## samples/nanopb/sample.yaml
```yaml
sample:
  description: nanopb for zephyr
    application
  name: nanopb
  platforms: all
common:
    tags: samples
    harness: console
    harness_config:
      type: one_line
      regex:
        - "nanopb (.*)"
```
